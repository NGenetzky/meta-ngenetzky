## conf/layer.conf
```bitbake
# We have a conf and classes directory, add to BBPATH
BBPATH .= ":${LAYERDIR}"

# We have recipes-* directories, add to BBFILES
BBFILES += " \
	${LAYERDIR}/recipes-*/*/*.bb \
	${LAYERDIR}/recipes-*/*/*.bbappend \
"

BBFILE_COLLECTIONS += "ngenetzky"
BBFILE_PATTERN_ngenetzky = "^${LAYERDIR}/"
BBFILE_PRIORITY_ngenetzky = "1"

# This should only be incremented on significant changes that will
# cause compatibility issues with other layers
LAYERVERSION_ngenetzky = "1"

LAYERDEPENDS_ngenetzky = "core"

LAYERSERIES_COMPAT_ngenetzky = "rocko"
```

## meta-appimage-bin/conf/layer.conf
```bitbake
# We have a conf and classes directory, add to BBPATH
BBPATH .= ":${LAYERDIR}"

# We have recipes-* directories, add to BBFILES
BBFILES += "${LAYERDIR}/recipes-*/*/*.bb \
            ${LAYERDIR}/recipes-*/*/*.bbappend"

BBFILE_COLLECTIONS += "meta-appimage-bin"
BBFILE_PATTERN_meta-appimage-bin = "^${LAYERDIR}/"
BBFILE_PRIORITY_meta-appimage-bin = "6"
```

## meta-hugo-host/conf/layer.conf
```bitbake
# We have a conf and classes directory, add to BBPATH
BBPATH .= ":${LAYERDIR}"

# We have recipes-* directories, add to BBFILES
BBFILES += "${LAYERDIR}/recipes-*/*/*.bb \
            ${LAYERDIR}/recipes-*/*/*.bbappend"

BBFILE_COLLECTIONS += "meta-hugo-host"
BBFILE_PATTERN_meta-hugo-host = "^${LAYERDIR}/"
BBFILE_PRIORITY_meta-hugo-host = "6"
```

## meta-win-portable-bin/conf/layer.conf
```bitbake
# We have a conf and classes directory, add to BBPATH
BBPATH .= ":${LAYERDIR}"

# We have recipes-* directories, add to BBFILES
BBFILES += "${LAYERDIR}/recipes-*/*/*.bb \
            ${LAYERDIR}/recipes-*/*/*.bbappend"

BBFILE_COLLECTIONS += "meta-win-portable-bin"
BBFILE_PATTERN_meta-win-portable-bin = "^${LAYERDIR}/"
BBFILE_PRIORITY_meta-win-portable-bin = "6"
```
